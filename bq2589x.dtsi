        bq25890@6A{
            compatible = "ti,bq2589x-1";
            reg = <0x6A>;
            ti,bq2589x,vbus-volt-high-level = <8700>;/* tune adapter to output 9v */
            ti,bq2589x,vbus-volt-low-level = <4400>;/* tune adapter to output 5v */
            ti,bq2589x,vbat-min-volt-to-tuneup = <3000>;
 
        };

        bq25892@6B{
            compatible = "ti,bq2589x-2";
            reg = <0x6B>;
      };